#include <U8g2lib.h>
#include "Ticker.h"

//U8G2_SSD1306_128X64_NONAME_F_HW_I2C u8g2(U8G2_R0, /* reset=*/U8X8_PIN_NONE);
U8G2_SSD1306_128X64_NONAME_F_4W_HW_SPI u8g2(U8G2_R0, /* cs=*/ 4, /* dc=*/ 5, /* reset=*/ 3); //使用7个引脚SPI屏幕的取消注释这行并注释掉上一行
char tcpu[25], scpuuti[25], scpuclk[25], fcpu[25],tgpudio[25],fcha[25],fgpu[25];//用来存着4个数值 cpu温度、cpu使用率、cpu频率、cpu风扇、gpu核心温度、机箱风扇转速、显卡风扇转速
char id[15];
char value[25];
byte inByte;
Ticker myTicker;
bool flag = false;
byte flag2 = 0;


// width: 108, height: 60 位图，将需要的显示的图片转为位图后将位图数组存放在此
const unsigned char col[] U8X8_PROGMEM = { 0x00,0x00,0x00,0x00,0x00,0x00,0x00,0x00,0x00,0x00,0x00,0x00,0x00,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0x00,0x00 };

void refresh1()
{
    u8g2.clearBuffer();                         // 清空显存
    u8g2.setFont(u8g2_font_unifont_t_chinese2); // 选一个合适的字体
    u8g2.drawStr(0, 15, "CPU Temp:");
    u8g2.drawStr(73, 15, tcpu);
    u8g2.drawStr(97, 15, "°C");
    u8g2.drawStr(0, 30, "CPU Util:");
    u8g2.drawStr(73, 30, scpuuti);
    u8g2.drawStr(105, 30, "%");
    u8g2.drawStr(0, 45, "CPU Freq:");
    u8g2.drawStr(73, 45, scpuclk);
    //u8g2.drawStr(105, 45, "MHz");
    u8g2.drawStr(105, 45, "GHz");
    u8g2.drawStr(0, 60, "CPU Fan:");
    u8g2.drawStr(73, 60, fcpu);
    u8g2.drawStr(105, 60, "RPM");
    u8g2.sendBuffer(); // 打到屏幕上
}

void refresh2(){
  u8g2.clearBuffer();                         // 清空显存
  u8g2.setFont(u8g2_font_unifont_t_chinese2); // 选一个合适的字体
  u8g2.drawStr(0, 15, "GPU Temp:");
  u8g2.drawStr(73, 15, tgpudio);
  u8g2.drawStr(97, 15, "°C");
  u8g2.drawStr(0, 30, "Chassis1:");
  u8g2.drawStr(73, 30, fcha);
  u8g2.drawStr(105, 30, "RPM");
  u8g2.drawStr(0, 45, "GPU FAN:");
  u8g2.drawStr(73, 45, fgpu);
  u8g2.drawStr(105, 45, "RPM");
  u8g2.sendBuffer(); // 打到屏幕上
}

void printImg(){
    u8g2.clearBuffer();
    u8g2.drawXBMP(12,0,108,60,col);
    u8g2.sendBuffer();
    delay(5000);
}

void emptyData(){
  u8g2.clearBuffer();                         // 清空显存
  u8g2.setFont(u8g2_font_unifont_t_chinese2); // 选一个合适的字体
  u8g2.drawStr(0,15,"---- EMPTY ----");
  u8g2.drawStr(0,30,"HelloWorld");
  u8g2.sendBuffer(); // 打到屏幕上
}

void setup()
{
    // put your setup code here, to run once:
    u8g2.begin();
    u8g2.enableUTF8Print(); //开启后能显示一些中文字
    Serial.begin(1500000);
    printImg();
    myTicker.attach(4,tickerHandle); //启动一个计时器
}

void get_serial(){
  if (Serial.available() > 0)
     {   //数据帧格式：<CPU Temperature=37>
         inByte = Serial.read();
         if (inByte == '<')
         {
             int i = 0;
             while (inByte != '=')
             {
                 while (Serial.available() == 0);
                 inByte = Serial.read();
                 if (inByte != '=')
                 {
                     id[i++] = inByte;
                 }
                 else
                 {
                     id[i] = '\0';
                 }
             }
             i = 0;
             while (inByte != '>')
             {
                 while (Serial.available() == 0);
                 inByte = Serial.read();
                 if (inByte != '>')
                 {
                     value[i++] = inByte;
                 }
                 else
                 {
                     value[i] = '\0';
                 }
             }
             i = 0;
             Serial.println(id); //如果需要显示其他的信息，去上位机输出里查名称
             Serial.println(value);
             if (strcmp("CPU Temperature", id) == 0) //显示cpu温度
                 strcpy(tcpu, value);
             if (strcmp("CPU Utilization", id) == 0) //显示cpu使用率
                 strcpy(scpuuti, value);
             if (strcmp("CPU Clock", id) == 0) //显示cpu频率
                 strcpy(scpuclk, value);
             if (strcmp("CPU FAN", id) == 0)
                 strcpy(fcpu, value);
             if (strcmp("GPU Diode", id) == 0)
                 strcpy(tgpudio, value);
             if (strcmp("Chassis #1", id) == 0)
                 strcpy(fcha, value);
             if (strcmp("GPU FAN",id) == 0)
                 strcpy(fgpu,value);
         }
      }
}

void tickerHandle(){ //计时器回调函数
  flag = true; //通过loop()函数中对标志位进行查询，从而进行定时运行
}


void loop()
{
  //将标志位归零
  if(flag2 >= 10){
    flag2 = 0;
  } 
  get_serial(); //获取串口信息
  if(flag){ //当计时器被启动时，将标志位进行递增，当计时器未被启动时，程序会进行显示信息的操作
    flag = false;
    flag2 ++;
  }else{
    //判断标志位是否能被2整除，从而判断显示哪个消息界面，因为计时器的作用，标志位每隔四秒才进行一次递增操作，所以在这期间程序将会显示一个界面，从而实现轮换界面的同时不断更新信息
    if(flag2 % 2 != 0){
      refresh2();
    }else{
      refresh1();
    }
    
  }
}
